/*
  Thanks to ZinggJM for his amazing EPD library:
  
  https://github.com/ZinggJM/GxEPD2
  
  
  20.11.2022 Antonio Velkov
*/


// base class GxEPD2_GFX can be used to pass references or pointers to the display instance as parameter, uses ~1.2k more code
// enable or disable GxEPD2_GFX base class
#define ENABLE_GxEPD2_GFX 0

// uncomment next line to use class GFX of library GFX_Root instead of Adafruit_GFX
//#include <GFX.h>
// Note: if you use this with ENABLE_GxEPD2_GFX 1:
//       uncomment it in GxEPD2_GFX.h too, or add #include <GFX.h> before any #include <GxEPD2_GFX.h>

//#include <GxEPD2_BW.h>
#include <GxEPD2_3C.h>
//#include <GxEPD2_7C.h>
#include <Fonts/FreeMonoBold9pt7b.h>
#include <U8g2_for_Adafruit_GFX.h>
#include <ESP8266WiFi.h>
#include <NTPClient.h>
#include <WiFiUdp.h>
#include <ESP8266HTTPClient.h>
#include <WiFiClient.h>
#include <Arduino_JSON.h>

// Replace with your network credentials
const char *ssid     = "your_SSID";
const char *password = "your_pass";

// Define NTP Client to get time
WiFiUDP ntpUDP;
NTPClient timeClient(ntpUDP, "pool.ntp.org");

const char* XCH_API = "https://min-api.cryptocompare.com/data/price?fsym=XCH&tsyms=USD";
const char* BTC_API = "https://min-api.cryptocompare.com/data/price?fsym=BTC&tsyms=USD";
const char* ETH_API = "https://min-api.cryptocompare.com/data/price?fsym=ETH&tsyms=USD";

// the following variables are unsigned longs because the time, measured in
// milliseconds, will quickly become a bigger number than can be stored in an int.
unsigned long lastTime = 0;
// Timer set to 10 minutes (600000)
//unsigned long timerDelay = 600000;
// Set timer to 5 seconds (5000)
unsigned long timerDelay = 60000;

String XCHPrice;
String BTCPrice;
String ETHPrice;

// or select the display class and display driver class in the following file (new style):
#include "GxEPD2_display_selection_new_style.h"

const unsigned char IMAGE_BLACK[] PROGMEM = { /* 0X00,0X01,0X68,0X00,0XD4,0X00, */
0XFF,0XFF,0XFF,0XDF,0XFF,0XFF,0XFF,0XFF,0XFF,0XFF,0XFF,0XFF,0XFF,0XFF,0XFF,0XFF,
0XDF,0XFF,0XFF,0XFF,0XFF,0XFF,0XFF,0XFF,0XFF,0XFF,0XFF,0XFF,0XFF,0XDF,0XFF,0XFF,
0XFF,0XFF,0XFF,0XFF,0XFF,0XFF,0XFF,0XFF,0XFF,0XFF,0XDF,0XFF,0XFF,0XFF,0XFF,0XFF,
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0XFF,0XFF,0XFF,0XFF,};

const unsigned char IMAGE_RED[] PROGMEM = { /* 0X00,0X01,0X68,0X00,0XD4,0X00, */
0X00,0X00,0X00,0X00,0X00,0X00,0X00,0X00,0X00,0X00,0X00,0X00,0X00,0X00,0X00,0X00,
0X00,0X00,0X00,0X00,0X00,0X00,0X00,0X00,0X00,0X00,0X00,0X00,0X00,0X00,0X00,0X00,
0X00,0X00,0X00,0X00,0X00,0X00,0X00,0X00,0X60,0X00,0X00,0X00,0X00,0X00,0X00,0X00,
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0X00,0X00,0X00,0X00,};

U8G2_FOR_ADAFRUIT_GFX u8g2Fonts;

//Week Days
String weekDays[7]={"Sun", "Mon", "Tue", "Wed", "Thu", "Fri", "Sat"};

//Month names
String months[12]={"Jan", "Feb", "Mar", "Arp", "May", "Jun", "Jul", "Aug", "Sep", "Oct", "Nov", "Dec"};

void setup()
{
  Serial.begin(115200);
  Serial.println();
  Serial.println("setup");
  delay(100);

  display.init(115200); // default 10ms reset pulse, e.g. for bare panels with DESPI-C02
  //display.init(115200, true, 2, false); // USE THIS for Waveshare boards with "clever" reset circuit, 2ms reset pulse
  //display.init(115200, true, 10, false, SPI0, SPISettings(4000000, MSBFIRST, SPI_MODE0)); // extended init method with SPI channel and/or settings selection
  // first update should be full refresh

  Wifi_ON();
  Init_Time();
    
  u8g2Fonts.begin(display);

  Main_Screen();
  DisplayTime();
  GetDataOnce();
  delay(60000);
}

void loop()
{
  GetData();
}

// note for partial update window and setPartialWindow() method:
// partial update window size and position is on byte boundary in physical x direction
// the size is increased in setPartialWindow() if x or w are not multiple of 8 for even rotation, y or h for odd rotation
// see also comment in GxEPD2_BW.h, GxEPD2_3C.h or GxEPD2_GFX.h for method setPartialWindow()

void GetData() {
  // Send an HTTP POST request depending on timerDelay
  if ((millis() - lastTime) > timerDelay) {
    //Check WiFi connection status
    if(WiFi.status()== WL_CONNECTED){
      DisplayTime();        
      XCHPrice = httpGETRequest(XCH_API);
      BTCPrice = httpGETRequest(BTC_API);
      ETHPrice = httpGETRequest(ETH_API);
      Serial.println(XCHPrice);
      Serial.println(BTCPrice);
      Serial.println(ETHPrice);
      JSONVar XCHObject = JSON.parse(XCHPrice);
      JSONVar BTCObject = JSON.parse(BTCPrice);
      JSONVar ETHObject = JSON.parse(ETHPrice);
  
      if (JSON.typeof(XCHObject) == "undefined") {
        Serial.println("Parsing input failed! XCHObject");
        return;
      }
       if (JSON.typeof(BTCObject) == "undefined") {
        Serial.println("Parsing input failed! BTCObject");
        return;
      }
       if (JSON.typeof(ETHObject) == "undefined") {
        Serial.println("Parsing input failed! ETHObject");
        return;
      }
    
      Serial.print("JSON object = ");
      Serial.println(XCHObject);
      Serial.println(BTCObject);
      Serial.println(ETHObject);
    
      JSONVar XCHkeys = XCHObject.keys();
      JSONVar BTCkeys = BTCObject.keys();
      JSONVar ETHkeys = ETHObject.keys();
      
      for (int i = 0; i < BTCkeys.length(); i++) {
        JSONVar value = BTCObject[BTCkeys[i]];
        Serial.print(BTCkeys[i]);
        Serial.print(" = ");
        Serial.println(value);
        DisplayBTC(double(value));
      }
      for (int i = 0; i < ETHkeys.length(); i++) {
        JSONVar value = ETHObject[ETHkeys[i]];
        Serial.print(ETHkeys[i]);
        Serial.print(" = ");
        Serial.println(value);
        DisplayETH(double(value));
      }
      for (int i = 0; i < XCHkeys.length(); i++) {
        JSONVar value = XCHObject[XCHkeys[i]];
        Serial.print(XCHkeys[i]);
        Serial.print(" = ");
        Serial.println(value);
        DisplayXCH(double(value));
      }
    }
    else {
      Serial.println("WiFi Disconnected");
    }
    lastTime = millis();
  }
 
}

void GetDataOnce() {
    //Check WiFi connection status
    if(WiFi.status()== WL_CONNECTED){
              
      XCHPrice = httpGETRequest(XCH_API);
      BTCPrice = httpGETRequest(BTC_API);
      ETHPrice = httpGETRequest(ETH_API);
      Serial.println(XCHPrice);
      Serial.println(BTCPrice);
      Serial.println(ETHPrice);
      JSONVar XCHObject = JSON.parse(XCHPrice);
      JSONVar BTCObject = JSON.parse(BTCPrice);
      JSONVar ETHObject = JSON.parse(ETHPrice);

      if (JSON.typeof(XCHObject) == "undefined") {
        Serial.println("Parsing input failed! XCHObject");
        return;
      }
       if (JSON.typeof(BTCObject) == "undefined") {
        Serial.println("Parsing input failed! BTCObject");
        return;
      }
       if (JSON.typeof(ETHObject) == "undefined") {
        Serial.println("Parsing input failed! ETHObject");
        return;
      }
    
      Serial.print("JSON object = ");
      Serial.println(XCHObject);
      Serial.println(BTCObject);
      Serial.println(ETHObject);

      JSONVar XCHkeys = XCHObject.keys();
      JSONVar BTCkeys = BTCObject.keys();
      JSONVar ETHkeys = ETHObject.keys();
      
      for (int i = 0; i < BTCkeys.length(); i++) {
        JSONVar value = BTCObject[BTCkeys[i]];
        Serial.print(BTCkeys[i]);
        Serial.print(" = ");
        Serial.println(value);
        DisplayBTC(double(value));
      }
      for (int i = 0; i < ETHkeys.length(); i++) {
        JSONVar value = ETHObject[ETHkeys[i]];
        Serial.print(ETHkeys[i]);
        Serial.print(" = ");
        Serial.println(value);
        DisplayETH(double(value));
      }
      for (int i = 0; i < XCHkeys.length(); i++) {
        JSONVar value = XCHObject[XCHkeys[i]];
        Serial.print(XCHkeys[i]);
        Serial.print(" = ");
        Serial.println(value);
        DisplayXCH(double(value));
      }

    }
    else {
      Serial.println("WiFi Disconnected");
    }

}

String httpGETRequest(const char* serverName) {
  WiFiClientSecure client;
  HTTPClient http;

  client.setInsecure();
  client.connect(serverName, 443);
  http.begin(client, serverName);
  
  // If you need Node-RED/server authentication, insert user and password below
  //http.setAuthorization("REPLACE_WITH_SERVER_USERNAME", "REPLACE_WITH_SERVER_PASSWORD");
  
  // Send HTTP POST request
  int httpResponseCode = http.GET();
  
  String payload = "{}"; 
  
  if (httpResponseCode>0) {
    Serial.print("HTTP Response code: ");
    Serial.println(httpResponseCode);
    payload = http.getString();
  }
  else {
    Serial.print("Error code: ");
    Serial.println(httpResponseCode);
  }
  // Free resources
  http.end();

  return payload;
}

void DisplayTime()
{
  timeClient.update();
  time_t epochTime = timeClient.getEpochTime();
  
  String weekDay = weekDays[timeClient.getDay()];
  struct tm *ptm = gmtime ((time_t *)&epochTime); 
  int monthDay = ptm->tm_mday;
  int currentMonth = ptm->tm_mon+1;
  String currentMonthName = months[currentMonth-1];
  int currentYear = ptm->tm_year+1900;
  int currentHour = timeClient.getHours();
  int currentMinute = timeClient.getMinutes();

  String Fulltime;

  if (currentMinute < 10) {
    Fulltime = String(weekDay) + ", " + String(monthDay) + "-" + currentMonthName + "-" + String(currentYear) + " " + String(currentHour) + ":0" + String(currentMinute);
    Serial.print(Fulltime);    
  } else {
  Fulltime = String(weekDay) + ", " + String(monthDay) + "-" + currentMonthName + "-" + String(currentYear) + " " + String(currentHour) + ":" + String(currentMinute);
  Serial.print(Fulltime);
  }
  
  Serial.println();

  display.setRotation(1);
  uint16_t bg = GxEPD_WHITE;
  uint16_t fg = GxEPD_BLACK;
  u8g2Fonts.setFontMode(1);                 // use u8g2 transparent mode (this is default)
  u8g2Fonts.setFontDirection(0);            // left to right (this is default)
  u8g2Fonts.setForegroundColor(fg);         // apply Adafruit GFX color
  u8g2Fonts.setBackgroundColor(bg);         // apply Adafruit GFX color
  u8g2Fonts.setFont(u8g2_font_profont12_tf);  // select u8g2 font from here: https://github.com/olikraus/u8g2/wiki/fntlistall

  display.setPartialWindow(0, 0, 180, 20);
  display.firstPage();
  do
  {
    display.fillScreen(bg);
    u8g2Fonts.setCursor(5, 17);
    u8g2Fonts.print(Fulltime);
  }
  while (display.nextPage());
  delay(100);
}

void DisplayBTC(double BTC) {
  
  display.setRotation(1);
  uint16_t bg = GxEPD_WHITE;
  uint16_t fg = GxEPD_BLACK;
  u8g2Fonts.setFontMode(1);                 // use u8g2 transparent mode (this is default)
  u8g2Fonts.setFontDirection(0);            // left to right (this is default)
  u8g2Fonts.setForegroundColor(fg);         // apply Adafruit GFX color
  u8g2Fonts.setBackgroundColor(bg);         // apply Adafruit GFX color
  u8g2Fonts.setFont(u8g2_font_profont17_tf);  // select u8g2 font from here: https://github.com/olikraus/u8g2/wiki/fntlistall

  display.setPartialWindow(45, 40, 100, 17);
  display.firstPage();
  do
  {
    display.fillScreen(bg);
    u8g2Fonts.setCursor(48, 54);
    u8g2Fonts.print(String(BTC) + " $");
  }
  while (display.nextPage());
  delay(100);
}

void DisplayETH(double ETH) {
  
  display.setRotation(1);
  uint16_t bg = GxEPD_WHITE;
  uint16_t fg = GxEPD_BLACK;
  u8g2Fonts.setFontMode(1);                 // use u8g2 transparent mode (this is default)
  u8g2Fonts.setFontDirection(0);            // left to right (this is default)
  u8g2Fonts.setForegroundColor(fg);         // apply Adafruit GFX color
  u8g2Fonts.setBackgroundColor(bg);         // apply Adafruit GFX color
  u8g2Fonts.setFont(u8g2_font_profont17_tf);  // select u8g2 font from here: https://github.com/olikraus/u8g2/wiki/fntlistall

  display.setPartialWindow(45, 75, 100, 17);
  display.firstPage();
  do
  {
    display.fillScreen(bg);
    u8g2Fonts.setCursor(48, 90);
    u8g2Fonts.print(String(ETH) + " $");
  }
  while (display.nextPage());
  delay(100);
}

void DisplayXCH(double XCH) {
  
  display.setRotation(1);
  uint16_t bg = GxEPD_WHITE;
  uint16_t fg = GxEPD_BLACK;
  u8g2Fonts.setFontMode(1);                 // use u8g2 transparent mode (this is default)
  u8g2Fonts.setFontDirection(0);            // left to right (this is default)
  u8g2Fonts.setForegroundColor(fg);         // apply Adafruit GFX color
  u8g2Fonts.setBackgroundColor(bg);         // apply Adafruit GFX color
  u8g2Fonts.setFont(u8g2_font_profont17_tf);  // select u8g2 font from here: https://github.com/olikraus/u8g2/wiki/fntlistall

  display.setPartialWindow(140, 75, 100, 17);
  display.firstPage();
  do
  {
    display.fillScreen(bg);
    u8g2Fonts.setCursor(145, 90);
    u8g2Fonts.print(String(XCH) + " $");
  }
  while (display.nextPage());
  delay(100);
}

void Main_Screen()
{ 
  display.setRotation(2);
  display.firstPage();
  
    do
    {
      display.fillScreen(GxEPD_WHITE);
      display.drawInvertedBitmap(0, 0, IMAGE_BLACK, display.epd2.WIDTH, display.epd2.HEIGHT, GxEPD_BLACK);
      display.drawBitmap(0, 0, IMAGE_RED, display.epd2.WIDTH, display.epd2.HEIGHT, GxEPD_RED);
    }
    
    while (display.nextPage());
    delay(100);
}

void Wifi_ON() {
    Serial.print("Connecting to ");
    Serial.println(ssid);
    
    display.setRotation(1);
    display.setFont(&FreeMonoBold9pt7b);
    display.setTextColor(GxEPD_BLACK);
    int16_t tbx, tby; uint16_t tbw, tbh;
    display.getTextBounds("Connecting to " + String(ssid), 0, 0, &tbx, &tby, &tbw, &tbh);
    // center bounding box by transposition of origin:
    uint16_t x = ((display.width() - tbw) / 2) - tbx;
    uint16_t y = ((display.height() - tbh) / 2) - tby;
    display.setFullWindow();
    display.firstPage();
    do
    {
      display.fillScreen(GxEPD_WHITE);
      display.setCursor(x, y);
      display.print("Connecting to " + String(ssid));
    }
    while (display.nextPage());
    
    WiFi.begin(ssid, password);
    while (WiFi.status() != WL_CONNECTED) {
    delay(500);
    Serial.print(".");
  }
}

void Init_Time() {
  // Initialize a NTPClient to get time
  timeClient.begin();
  // Set offset time in seconds to adjust for your timezone, for example:
  // GMT +1 = 3600
  // GMT +8 = 28800
  // GMT -1 = -3600
  // GMT 0 = 0
  timeClient.setTimeOffset(7200);
}
